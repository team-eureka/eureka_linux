## Documentation/devicetree/bindings/gpio/snps-dwapb-gpio.txt
```
* Synopsys DesignWare APB GPIO controller

Required properties:
- compatible : Should be "snps,dw-apb-gpio"
- reg : Address and length of the register set for the device

The GPIO controller has a configurable number of banks, each of which are
represented as child nodes with the following properties:

Required properties:
- compatible : "snps,dw-apb-gpio-bank"
- gpio-controller : Marks the device node as a gpio controller.
- #gpio-cells : Should be two.  The first cell is the pin number and
  the second cell is used to specify optional parameters (currently
  unused).
- reg : The integer bank index of the bank, a single cell.
- nr-gpio : The number of pins in the bank, a single cell.

Optional properties:
- interrupt-controller : The first bank may be configured to be an interrupt
controller.
- #interrupt-cells : Specifies the number of cells needed to encode an
interrupt.  Shall be set to 2.  The first cell defines the interrupt number,
the second encodes the triger flags encoded as described in
Documentation/devicetree/bindings/interrupts.txt
- interrupt-parent : The parent interrupt controller.
- interrupts : The interrupts to the parent controller raised when GPIOs
generate the interrupts.

Example:

gpio: gpio@20000 {
	compatible = "snps,dw-apb-gpio";
	reg = <0x20000 0x1000>;
	#address-cells = <1>;
	#size-cells = <0>;

	banka: gpio-controller@0 {
		compatible = "snps,dw-apb-gpio-bank";
		gpio-controller;
		#gpio-cells = <2>;
		nr-gpio = <8>;
		reg = <0>;
		interrupt-controller;
		#interrupt-cells = <2>;
		interrupt-parent = <&vic1>;
		interrupts = <0 1 2 3 4 5 6 7>;
	};

	bankb: gpio-controller@1 {
		compatible = "snps,dw-apb-gpio-bank";
		gpio-controller;
		#gpio-cells = <2>;
		nr-gpio = <8>;
		reg = <1>;
	};
};
```

## arch/arm/configs/eureka_basic_yaffs2_defconfig
```kconfig
# CONFIG_ARM_PATCH_PHYS_VIRT is not set
CONFIG_PHYS_OFFSET=0x0600000
CONFIG_EXPERIMENTAL=y
# CONFIG_LOCALVERSION_AUTO is not set
CONFIG_KERNEL_LZO=y
# CONFIG_SWAP is not set
CONFIG_SYSVIPC=y
CONFIG_POSIX_MQUEUE=y
CONFIG_IKCONFIG=y
CONFIG_IKCONFIG_PROC=y
CONFIG_CGROUPS=y
CONFIG_CGROUP_CPUACCT=y
CONFIG_CGROUP_SCHED=y
CONFIG_NAMESPACES=y
# CONFIG_UTS_NS is not set
# CONFIG_IPC_NS is not set
CONFIG_BLK_DEV_INITRD=y
CONFIG_SYSCTL_SYSCALL=y
# CONFIG_BASE_FULL is not set
CONFIG_EMBEDDED=y
# CONFIG_SLUB_DEBUG is not set
CONFIG_PROFILING=y
CONFIG_OPROFILE=y
CONFIG_JUMP_LABEL=y
CONFIG_MODULES=y
CONFIG_MODULE_UNLOAD=y
CONFIG_PARTITION_ADVANCED=y
CONFIG_LDM_PARTITION=y
CONFIG_ARCH_BERLIN=y
CONFIG_BERLIN_GPIO=y
CONFIG_BERLIN_GPU=y
CONFIG_BERLIN_GPU3D=y
# CONFIG_BERLIN_GPUMEM_FROM_SHM is not set
CONFIG_BERLIN_GPUMEM_SIZE=0x8000000
CONFIG_BERLIN_PE=y
CONFIG_BERLIN_PXA3XX_NFC=y
CONFIG_BERLIN_NAND_RANDOMIZER=y
CONFIG_BERLIN_SDIO_WLAN_8787=m
CONFIG_BERLIN_FASTLOGO=y
CONFIG_ARM_THUMBEE=y
CONFIG_SWP_EMULATE=y
CONFIG_PREEMPT=y
CONFIG_AEABI=y
# CONFIG_OABI_COMPAT is not set
# CONFIG_COMPACTION is not set
CONFIG_ZBOOT_ROM_TEXT=0x0
CONFIG_ZBOOT_ROM_BSS=0x0
CONFIG_ARM_APPENDED_DTB=y
CONFIG_ARM_ATAG_DTB_COMPAT=y
CONFIG_CMDLINE="console=ttyS0,115200"
CONFIG_CMDLINE_EXTEND=y
CONFIG_VFP=y
CONFIG_NEON=y
# CONFIG_CORE_DUMP_DEFAULT_ELF_HEADERS is not set
# CONFIG_SUSPEND is not set
CONFIG_NET=y
CONFIG_PACKET=y
CONFIG_UNIX=y
CONFIG_INET=y
CONFIG_IP_MULTICAST=y
# CONFIG_INET_XFRM_MODE_TRANSPORT is not set
# CONFIG_INET_XFRM_MODE_TUNNEL is not set
# CONFIG_INET_XFRM_MODE_BEET is not set
# CONFIG_INET_LRO is not set
# CONFIG_INET_DIAG is not set
# CONFIG_IPV6 is not set
CONFIG_CFG80211=m
CONFIG_CFG80211_WEXT=y
CONFIG_RFKILL=y
CONFIG_UEVENT_HELPER_PATH="/sbin/mdev"
CONFIG_DEVTMPFS=y
# CONFIG_FIRMWARE_IN_KERNEL is not set
CONFIG_MTD=y
CONFIG_MTD_CMDLINE_PARTS=y
# CONFIG_MTD_OF_PARTS is not set
CONFIG_MTD_CHAR=y
CONFIG_MTD_BLOCK=y
CONFIG_MTD_NAND=y
CONFIG_BLK_DEV_LOOP=y
CONFIG_BLK_DEV_RAM=y
CONFIG_BLK_DEV_RAM_COUNT=1
CONFIG_BLK_DEV_RAM_SIZE=32768
CONFIG_FLASH_TS=y
CONFIG_SCSI=y
# CONFIG_SCSI_PROC_FS is not set
CONFIG_BLK_DEV_SD=y
CONFIG_CHR_DEV_SG=y
CONFIG_SCSI_MULTI_LUN=y
CONFIG_SCSI_SCAN_ASYNC=y
# CONFIG_SCSI_LOWLEVEL is not set
CONFIG_NETDEVICES=y
# CONFIG_NET_CADENCE is not set
# CONFIG_NET_VENDOR_BROADCOM is not set
# CONFIG_NET_VENDOR_CIRRUS is not set
# CONFIG_NET_VENDOR_FARADAY is not set
# CONFIG_NET_VENDOR_INTEL is not set
CONFIG_BERLIN_FASTETH=y
# CONFIG_NET_VENDOR_MICREL is not set
# CONFIG_NET_VENDOR_NATSEMI is not set
# CONFIG_NET_VENDOR_SEEQ is not set
# CONFIG_NET_VENDOR_SMSC is not set
# CONFIG_NET_VENDOR_STMICRO is not set
# CONFIG_NET_VENDOR_WIZNET is not set
CONFIG_USB_RTL8150=y
CONFIG_INPUT_FF_MEMLESS=y
# CONFIG_INPUT_MOUSEDEV is not set
CONFIG_INPUT_EVDEV=y
# CONFIG_INPUT_KEYBOARD is not set
# CONFIG_INPUT_MOUSE is not set
CONFIG_INPUT_MISC=y
CONFIG_INPUT_UINPUT=y
# CONFIG_SERIO is not set
# CONFIG_VT is not set
# CONFIG_LEGACY_PTYS is not set
# CONFIG_DEVKMEM is not set
CONFIG_SERIAL_8250=y
CONFIG_SERIAL_8250_CONSOLE=y
CONFIG_SERIAL_8250_DW=y
# CONFIG_HW_RANDOM is not set
CONFIG_HWMON=m
CONFIG_SENSORS_MV88DE3100=m
CONFIG_WATCHDOG=y
CONFIG_MV88DE3100_WDT=y
# CONFIG_HID is not set
# CONFIG_USB_HID is not set
CONFIG_USB=y
CONFIG_USB_ANNOUNCE_NEW_DEVICES=y
CONFIG_USB_DYNAMIC_MINORS=y
CONFIG_USB_EHCI_HCD=y
CONFIG_USB_EHCI_BERLIN=y
CONFIG_USB_STORAGE=y
CONFIG_MMC=y
# CONFIG_MMC_BLOCK is not set
CONFIG_MMC_SDHCI=y
CONFIG_MMC_SDHCI_PLTFM=y
CONFIG_MMC_SDHCI_MV=y
CONFIG_STAGING=y
CONFIG_ANDROID=y
CONFIG_ASHMEM=y
CONFIG_ANDROID_LOGGER=y
# CONFIG_ANDROID_TIMED_OUTPUT is not set
# CONFIG_IOMMU_SUPPORT is not set
CONFIG_EXT2_FS=y
# CONFIG_DNOTIFY is not set
CONFIG_FUSE_FS=m
CONFIG_MSDOS_FS=y
CONFIG_VFAT_FS=y
# CONFIG_PROC_PAGE_MONITOR is not set
CONFIG_TMPFS=y
CONFIG_YAFFS_FS=y
CONFIG_YAFFS_DISABLE_TAGS_ECC=y
CONFIG_SQUASHFS=y
CONFIG_SQUASHFS_EMBEDDED=y
# CONFIG_NETWORK_FILESYSTEMS is not set
CONFIG_NLS_CODEPAGE_437=y
CONFIG_NLS_ISO8859_1=y
CONFIG_NLS_UTF8=y
CONFIG_PRINTK_TIME=y
CONFIG_DETECT_HUNG_TASK=y
# CONFIG_SCHED_DEBUG is not set
CONFIG_TIMER_STATS=y
# CONFIG_DEBUG_PREEMPT is not set
# CONFIG_DEBUG_BUGVERBOSE is not set
# CONFIG_FTRACE is not set
# CONFIG_ARM_UNWIND is not set
CONFIG_DEBUG_USER=y
CONFIG_KEYS=y
CONFIG_CRYPTO_CBC=y
CONFIG_CRYPTO_ECB=y
CONFIG_CRYPTO_HMAC=y
CONFIG_CRYPTO_CRC32C=y
CONFIG_CRYPTO_MD4=y
CONFIG_CRYPTO_MD5=y
CONFIG_CRYPTO_SHA256=y
CONFIG_CRYPTO_ARC4=y
CONFIG_CRYPTO_DES=y
CONFIG_CRYPTO_TWOFISH=y
# CONFIG_CRYPTO_ANSI_CPRNG is not set
# CONFIG_CRYPTO_HW is not set
CONFIG_CRC_CCITT=y
CONFIG_CRC16=y
CONFIG_CRC_ITU_T=y
```

## arch/arm/mach-berlin/Kconfig
```kconfig
if ARCH_BERLIN

menu "Marvell Berlin SoCs Support"

choice
	prompt "Select Berlin SoC family for target system"

config ARCH_BERLIN2
	bool "BG2"
	select ARCH_REQUIRE_GPIOLIB
	select USB_ARCH_HAS_EHCI if USB_SUPPORT
	help
	  Support for Marvell Berlin Generation 2 SoCs, based on the
	  ARM CortexA9 CPU and the ARM PL310 L2 cache controller
endchoice

choice
	prompt "Choose SoCs"
	default BERLIN2CDP
	depends on ARCH_BERLIN2
	help
	  This option allows to select a SoC version.

config BERLIN2CD
	bool "BG2 CD"
	select ARM_ERRATA_754322
	select ARM_ERRATA_775420
	help
	  BG2 CD version

config BERLIN2Q
	bool "BG2 Q"
	select ARM_ERRATA_754322
	select ARM_ERRATA_764369 if SMP
	help
	  BG2 Q version

config BERLIN2CDP
	bool "BG2 CDp Common"
	help
	  BG2 CD+ version
endchoice


menu "BERLIN2 features"

config  BERLIN_ASIC
	bool "Support ASIC Version"
	default y
	help
	  Berlin has FPGA and ASIC version. Say Y to support ASIC version.
endmenu

comment "BERLIN modules"

config BERLIN_SHM
	tristate "Support Shared Memory(SHM)"
	default y
	help
	  This module implements the shared memory access.

config BERLIN_CC
	tristate "Support Common Communication(CC)"
	default y
	help
	  This module implements the interprocess communication scheme
	  for Marvell Berlin SoCs

config BERLIN_GPIO
	tristate "Support GPIO port operations from user space"
	default n
	help
	  Enable support for GPIO control from user space

config BERLIN_I2C
	tristate "Support I2C bus"
	default y
	help
	  Enable support fo I2C bus in Berlin SoC

config BERLIN_GPU
    tristate "SoC's 2d GPU support"
    default m
    help
      2D GPU support

config BERLIN_GPU3D
    tristate "SoC's 3d GPU support"
    default m
    help
      3D GPU support

config BERLIN_GPUMEM_FROM_SHM
        bool "allocate GPU memory from SHM"
        default y
        help
          set to y to allocate GPU memory from SHM;
          if reserve GPU MEM in Linux kernel, then set to n

config BERLIN_PE
    tristate "Support Presentation Engine"
    default m
    help
      Enable support for Presentation Engine

config BERLIN_AMP
    tristate "Support AMP"
    default m
    help
      Enable support for AMP

config BERLIN_TZDD
    tristate "Support TrustZone"
    select BERLIN_TZDD_CB
    default m
    help
      Enable support for ARM TrustZone

config BERLIN_TZDD_CB
    tristate "Support TrustZone Callback"
	depends on BERLIN_TZDD
    default m
    help
      Enable support for TrustZone event callback

config BERLIN_PXA3XX_NFC
	tristate "Support NAND Flash Controller (fork of pxa3xx_nand)"
	default n
	help
	  A fork of mainline pxa3xx_nand.c. This NFC has no dedicated interrupt, but SoC
	  contains a powerfull pbridge DMA engine whose interrupt can be enabled/disabled.
	  So the driver could work in 3 modes: nonDMA, polling-DMA, interrupt-DMA.

config BERLIN_NAND_RANDOMIZER
	bool "Support software NAND randomizer"
	default n
	depends on BERLIN_PXA3XX_NFC
	help
	  To improve data stability for some large-capacity MLC(multipil-level cell) chips,
	  data have to be randomized before storing into, or
	  derandomized after reading out, from the physical cells.
	  For chips that don't build in HW randomizer, SW randomizer is needed.
	  Say Y here if you have no idea

config BERLIN_NAND_READ_RETRY
	bool "Support NAND read retry when ecc fail in read operation"
	default y
	depends on BERLIN_PXA3XX_NFC
	help
	  To improve nand read ability of error correction. When ecc fail in read operation,
	  change the read cmd parameter of nand chip. Every kind of Nand chip's READ RETRY feature
	  diff from each other. If nand chip do not support READ RETRY, this feature will do nothing.
	  Now support only hynix nand chip read retry.

config BERLIN_SDIO_WLAN_8787
	tristate "SDIO Wlan (IEEE802.11 A|B|G|N) driver for wlan8787 module"
	default n
	depends on MMC_SDHCI_MV
	select WIRELESS_EXT
	select WEXT_PRIV
	select WEXT_SPY
	help
	  This is the wifi module for Berlin. Please try build it for module only.
config BERLIN_SDIO_WLAN_8797
	tristate "SDIO Wlan (IEEE802.11 A|B|G|N) driver for wlan8797 module"
	default n
	depends on MMC_SDHCI_MV
	select WIRELESS_EXT
	select WEXT_PRIV
	select WEXT_SPY
	help
	  This is the wifi module for Berlin. Please try build it for module only.

config BERLIN_SDIO_WLAN_8801
	tristate "SDIO Wlan (IEEE802.11 A|B|G|N) driver for wlan8801 module"
	default n
	depends on MMC_SDHCI_MV
	select WIRELESS_EXT
	select WEXT_PRIV
	select WEXT_SPY
	help
	  This is the wifi module for Berlin. Please try build it for module only.

config BERLIN_SDIO_WLAN_8887
	tristate "SDIO Wlan (IEEE802.11 A|B|G|N) driver for wlan8887 module"
	default n
	depends on MMC_SDHCI_MV
	select WIRELESS_EXT
	select WEXT_PRIV
	select WEXT_SPY
	help
	  This is the wifi module for Berlin. Please try build it for module only.

config BERLIN_SDIO_BT_8887
        tristate "SDIO Bluetooth/BLE support for Marvell's 8887 SoC"
        default m
	depends on CONFIG_BT
	depends on CONFIG_BT_RFCOMM
	depends on CONFIG_BT_RFCOMM_TTY
	depends on CONFIG_BT_BNEP
	depends on CONFIG_BT_BNEP_MC_FILTER
	depends on CONFIG_BT_BNEP_PROTO_FILTER
	depends on CONFIG_BT_HIDP
	depends on CONFIG_BT_MRVL
	depends on CONFIG_HID
	depends on CONFIG_HIDRAW
	depends on CONFIG_UHID
	depends on CONFIG_HID_GENERIC
        help
          This is defualt bluetooth module for Berlin based platform.

config BERLIN_SDIO_BT_8887_CHAR_DRV
        tristate "SDIO Bluetooth/BLE Bluedroid support for Marvell's 8887 SoC"
        default m
	depends on !CONFIG_BT
	depends on !CONFIG_BT_RFCOMM
	depends on !CONFIG_BT_RFCOMM_TTY
	depends on !CONFIG_BT_BNEP
	depends on !CONFIG_BT_BNEP_MC_FILTER
	depends on !CONFIG_BT_BNEP_PROTO_FILTER
	depends on !CONFIG_BT_HIDP
	depends on !CONFIG_BT_MRVL
        help
          This is defualt bluetooth module for Berlin based platform using Bluedroid stack.

config BERLIN_FASTLOGO
	tristate "Support fast logo"
	default n
	help
	  Enable support for fast logo
	  
config BERLIN_PWM
	bool "Support PWM"
	default y
	help
	  Enable support for PWM	  

endmenu

endif
```

## arch/arm/mach-berlin/modules/tzdd/Kconfig
```kconfig
menuconfig MV_TZDD
	tristate "Enable Trust Zone Device Driver"
	depends on TZ_HYPERVISOR
	default m
help
	Marvell Trust Execution Environment (TEE) Solution in non-trusted world
```

## sound/soc/berlin/Kconfig
```kconfig
config SND_SOC_BERLIN
        tristate "SoC Audio for the BERLIN chip"
        select SND_ARM
        select SND_BERLIN_LIB
        select SND_HWDEP
```
